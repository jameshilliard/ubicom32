## ubicom-linux-dist-3.2.1/linux-2.6.x/arch/ubicom32/Kconfig.debug
```kconfig
menu "Kernel hacking"

config TRACE_IRQFLAGS_SUPPORT
	def_bool y

config DEBUG_VERBOSE
        bool "Verbose fault messages"
        default y
        select PRINTK
        help
          When a program crashes due to an exception, or the kernel detects
          an internal error, the kernel can print a not so brief message
          explaining what the problem was. This debugging information is
          useful to developers and kernel hackers when tracking down problems,
          but mostly meaningless to other people. This is always helpful for
          debugging but serves no purpose on a production system.
          Most people should say N here.
	
if UBICOM32_V3 || UBICOM32_V4
config PROTECT_KERNEL
	default y
	bool 'Enable Kernel range register Protection'
	depends on !SLOB
	help
	  Adds code to enable/disable range registers to protect static
	  kernel code/data from userspace.  Currently the ranges covered
	  do no protect kernel loadable modules or dynamically allocated
	  kernel data.
endif

config BUG_ON_ALLOC_FAIL
	bool "BUG_ON allocation failures"
	help
	  BUG on allocation failures in the page alloctor or slab.

config NO_KERNEL_MSG
	bool "Suppress Kernel BUG Messages"
	help
	  Do not output any debug BUG messages within the kernel.

config EARLY_PRINTK
	bool "Use the driver that you selected as console also for early printk (to debug kernel bootup)."
	default n
	help
	  If you want to use the serdes driver (console=ttyUS0) for
	  early printk, you must also supply an additional kernel boot
	  parameter like this:

		serdes=ioportaddr,irq,clockrate,baud

	  For an IP7160RGW eval board, you could use this:

		serdes=0x2004000,61,250000000,57600

	  which will let you see early printk output at 57600 baud.

config UBICOM32_STALL_ENABLED
	bool "Enable Ubicom32 Thread Stalling Feature"
	default n
	help
	Enables the Ubicom32 bkpt #-1 instruction to be used at
	various points to stall system execution.  A debugger
	can be attached to examine system state or to continue
	from the stall.

config UBICOM32_STALL_ON_BUG
	bool "Enable stalling on failed BUG_ON()"
	default n
	depends on UBICOM32_STALL_ENABLED
	help
	Causes all BUG_ON failures to stall all threads

config UBICOM32_STALL_ON_TRAP_MARKER
	bool "Enable stalling just after printing the trap marker"
	default n
	depends on UBICOM32_STALL_ENABLED
	help
	Causes the system to stall just after printing a trap marker.

config UBICOM32_STALL_ON_EMERGENCY_REBOOT
	bool "Enable stalling before reboots caused by panic()"
	default n
	depends on UBICOM32_STALL_ENABLED
	help
	Causes the system to stall before reboots caused by panic()

config UBICOM32_STOPWATCH
	bool "Enable Ubicom32 Stop Watch Feature"
	default n
	help
	Adds a stop watch capability to the Ubicom32 Linux port enabling
	code sequences to be measured with cycle accuracy and displayed
	as a /proc/stopwatch/<name>.

config UBICOM32_STOPWATCH_IRQ
	bool "Enable measurements for IRQ handlers"
	default n
	depends on UBICOM32_STOPWATCH
	help
	When enabled each IRQ's min/avg/max times will be printed.  If the handler
	re-enables interrupt, the times will show the full time including to service
	nested interrupts.  See /proc/stopwatch/irq.

config UBICOM32_STOPWATCH_SOFTIRQ
	bool "Enable measurements for Soft IRQs"
	default n
	depends on UBICOM32_STOPWATCH
	help
	When enabled each Soft IRQ's min/avg/max times will be printed.  If the handler
	re-enables interrupt, the times will show the full time including to service
	nested interrupts.  See /proc/stopwatch/softirq.

config UBICOM32_STOPWATCH_PCI
	bool "Enable measurements for PCI"
	default n
	depends on UBICOM32_STOPWATCH
	help
	When enabled the system will measure the min/avg/max timer for each PCI transactions.
	See /proc/stopwatch/pci.

config UBICOM32_STOPWATCH_USB
	bool "Enable measurements for USB"
	default n
	depends on UBICOM32_STOPWATCH
	help
	When enabled the system will measure the min/avg/max timer for USB routines.
	See /proc/stopwatch/usb_watch.

config UBICOM32_STOPWATCH_CRYPTO
	bool "Enable measurements for Ubicom crypto engine."
	default n
	depends on UBICOM32_STOPWATCH
	help
	When enabled the system will measure the min/avg/max timer for each SHA1/SHA2/MD5 update routines.
	See /proc/stopwatch/sha1, /proc/stopwatch/sha2, /proc/stopwatch/md5.

config ACCESS_OK_CHECKS_ENABLED
	bool "Enable user space access checks"
	default n
	help
	Enabling this check causes the kernel to verify that addresses passed
	to the kernel by the user space code are within the processes
	address space.  On a no-mmu system, this is done by examining the
	processes memory data structures (adversly affecting performance) but
	ensuring that a process does not ask the kernel to violate another
	processes address space.  Sadly, the kernel uses access_ok() for
	address that are in the kernel which results in a large volume of
	false positives.

choice
	prompt "Unaligned Access Support"
	default UNALIGNED_ACCESS_ENABLED
	help
		Kernel / Userspace unaligned access handling.

config  UNALIGNED_ACCESS_ENABLED
	bool "Kernel and Userspace"
	help

config  UNALIGNED_ACCESS_USERSPACE_ONLY
	bool "Userspace Only"
	help

config  UNALIGNED_ACCESS_DISABLED
	bool "Disabled"
	help

endchoice

config DEBUG_STACKOVERFLOW
	bool "Check for stack overflows"
	default n
	depends on DEBUG_KERNEL
	help
	  This option will cause messages to be printed if free kernel stack space
	  drops below a certain limit (THREAD_SIZE /8).

config DEBUG_STACK_USAGE
	bool "Stack utilization instrumentation"
	default n
	depends on DEBUG_KERNEL
	help
	  Enables the display of the minimum amount of free kernel stack which each
	  task has ever had available in the sysrq-T and sysrq-P debug output.

	  This option will slow down process creation somewhat.

config MODULE_KMALLOC
	bool "Alloc kernel modules using kmalloc"
	default n
	depends on DEBUG_KERNEL && MODULES
	help
	  Using kmalloc to make kernel module debug easy

source "lib/Kconfig.debug"

endmenu
```

## ubicom-linux-dist-3.2.1/linux-2.6.x/arch/ubicom32/mach-common/Kconfig
```kconfig
#
# used by VDC
#
config VDC_LCD_BITBANG_16
	bool
	default n

config VDC_LCD_BITBANG_8
	bool
	default n

config VDC_LCD_BITBANG_8_SPLIT
	bool
	default n

config VDC_LCD_SYNC
	bool
	default n

config VDC_LCD_DIRECT
	bool
	default n

config VDC_LCD_BITBANG_DISPLAY
	bool
	default n
	help
		Selected automagically when a bitbang display is selected.
```

## ubicom-linux-dist-3.2.1/linux-2.6.x/arch/ubicom32/mach-common/Kconfig.VDC
```kconfig
# These are generic boards for which we have the init scripts and
# parameters set in vdc_tio.c.  New boards which are not connected
# in the standard way may use these defines but modify the resulting
# platform data to suit their connections.
#
# All of the following displays are connected as follows:
#	Data Bus: PI15-PI0 (16-bit), PI7-PI0 (8-bit)
#	CS      : PD4
#	RS      : PD3
#	WR      : PD2
#	RD      : PD5
#	RESET   : PD7
#

config VDC_NOAUTODETECT
	bool

choice
	prompt "Display Type"
	depends on VDC_NOAUTODETECT
	help
		Choose a display type for use with the board.

config VDC_LCD_TFT1N5046E_LANDSCAPE
	bool "TFT1N5046E Landscape - 16 bit bus"
	depends on VDC_LCD_BITBANG_16
	select VDC_LCD_BITBANG_DISPLAY
	help
		Truly Semiconductor TFT1N5046E
		Truly Semiconductor TFT2N0369E

config VDC_LCD_TFT1N5046E_PORTRAIT
	bool "TFT1N5046E Portrait - 16 bit bus"
	depends on VDC_LCD_BITBANG_16
	select VDC_LCD_BITBANG_DISPLAY
	help
		Truly Semiconductor TFT1N5046E
		Truly Semiconductor TFT2N0369E

config VDC_LCD_TFT1N5046E_LANDSCAPE_8
	bool "TFT1N5046E Landscape - 8 bit bus"
	depends on VDC_LCD_BITBANG_8
	select VDC_LCD_BITBANG_DISPLAY
	help
		Truly Semiconductor TFT1N5046E
		Truly Semiconductor TFT2N0369E

config VDC_LCD_TFT1N5046E_PORTRAIT_8
	bool "TFT1N5046E Portrait - 8 bit bus"
	depends on VDC_LCD_BITBANG_8
	select VDC_LCD_BITBANG_DISPLAY
	help
		Truly Semiconductor TFT1N5046E
		Truly Semiconductor TFT2N0369E

config VDC_LCD_TFT1N5046E_LANDSCAPE_8_SPLIT
	bool "TFT1N5046E Landscape - 8 bit split bus"
	depends on VDC_LCD_BITBANG_8_SPLIT
	select VDC_LCD_BITBANG_DISPLAY
	help
		Truly Semiconductor TFT1N5046E
		Truly Semiconductor TFT2N0369E

config VDC_LCD_TFT1N5046E_PORTRAIT_8_SPLIT
	bool "TFT1N5046E Portrait - 8 bit split bus"
	depends on VDC_LCD_BITBANG_8_SPLIT
	select VDC_LCD_BITBANG_DISPLAY
	help
		Truly Semiconductor TFT1N5046E
		Truly Semiconductor TFT2N0369E

config VDC_LCD_CFAF240320KT_PORTRAIT
	bool "CFAF240320KT Portrait"
	depends on VDC_LCD_BITBANG_16
	select VDC_LCD_BITBANG_DISPLAY
	help
		Crystalfontz CFAF240320KT
		Crystalfontz CFAF240320KTTS


config VDC_LCD_CFAF240320KT_PORTRAIT_180
	bool "CFAF240320KT Portrait 180 degrees"
	depends on VDC_LCD_BITBANG_16
	select VDC_LCD_BITBANG_DISPLAY
	help
		Crystalfontz CFAF240320KT
		Crystalfontz CFAF240320KTTS

config VDC_LCD_CFAF240400DT_PORTRAIT
	bool "CFAF240400DT Portrait"
	depends on VDC_LCD_BITBANG_16
	select VDC_LCD_BITBANG_DISPLAY
	help
		Crystalfontz CFAF240400DT

config VDC_LCD_CFAF320240FT_LANDSCAPE
	bool "CFAF320240FT / CFAF320240FTTS Landscape"
	depends on VDC_LCD_BITBANG_16
	select VDC_LCD_BITBANG_DISPLAY
	help
		Crystalfontz CFAF320240FT   (No touch screen)
		Crystalfontz CFAF320240FTTS (Touch screen)

config VDC_LCD_HX8347_LANDSCAPE
	bool "HX8347 Landscape"
	depends on VDC_LCD_BITBANG_16
	select VDC_LCD_BITBANG_DISPLAY
	help
		Himax HX8347 (Touch screen)

config VDC_LCD_HX8347_PORTRAIT
	bool "HX8347 Portrait"
	depends on VDC_LCD_BITBANG_16
	select VDC_LCD_BITBANG_DISPLAY
	help
		Himax HX8347 (Touch screen)

#
# All of the following displays are connected via PLIO SYNC
#	HSYNC : PD5
#	VSYNC : PD4
#	DCLK  : PD7
#	DEN   : PD6
#
config VDC_LCD_LG_LB070WV6
	bool "LG LB070WV6 7 inch"
	depends on VDC_LCD_SYNC
	help
		LG LB070WV6(TD)(06) with or without touch screen

config VDC_LCD_INNOLUX_AT070TN93
	bool "Innolux AT070TN93 7 inch"
	depends on VDC_LCD_SYNC
	help
		Innolux AT070TN93 with or without touch screen

config VDC_LCD_TFT1N5046E_HV
	bool "TFT1N5046E Sync"
	depends on VDC_LCD_SYNC
	help
		Truly Semiconductor TFT1N5046E
		Truly Semiconductor TFT2N0369E

		In HV Sync mode

#
# All of the following displays are connected via PLIO DIRECT
#	LD   : PD1
#	CKV  : PD2
#	OEV  : PD3
#	STVU : PD5
#	STHL : PD6
#	POL  : PD4
#	DCLK : PD7

config VDC_LCD_INNOLUX_AT080TN42
	bool "Innolux AT080TN42 8 inch"
	depends on VDC_LCD_DIRECT
	help
		Innolux AT080TN42 with or without touch screen

endchoice
```

## ubicom-linux-dist-3.2.1/linux-2.6.x/arch/ubicom32/mach-common/Kconfig.board
```kconfig
#
# Kconfig entries relevant to all boards
#

#
# used by VDC
#
config VDC_LCD_AUTO_REFRESH_RATE
	int "LCD Automatic Refresh Rate"
	depends on VDC_LCD_BITBANG_DISPLAY
	default 30
	help
		This is the rate at which Self-Refresh displays will be refreshed
		by the VDC.  Set this to 0 to make the VDC refresh on demand.
		Otherwise, set this number to the requested number of frames per
		second.

		Displays which are not Self-Refresh will be refreshed by the VDC
		as specified by the VDCTIO (see ultra config).
```

## ubicom-linux-dist-3.2.1/linux-2.6.x/arch/ubicom32/mach-common/Kconfig.usb
```kconfig
menu "USB Controllers"
config UBI32_DWC_OTG
	bool "Synopsys DWC OTG"
	depends on UBICOM32_V5
	default y
	help
	  Enable/Disable Synopsys DWC USB 2.0 OTG support.

config DWC_PORT0_ENABLE
	bool "USB 2.0 port 0"
	depends on UBI32_DWC_OTG
	default y
	help
	  Enable/Disable the first DWC OTG port.
	
choice 
	prompt "Controller mode"
	default DWC_PORT0_OTG
	depends on DWC_PORT0_ENABLE

config DWC_PORT0_OTG
	bool "OTG"
	help
	  OTG

config DWC_PORT0_HOST
	bool "Host only"
	help
	  Port 0 works in host only mode

config DWC_PORT0_DEVICE
	bool "Device only"
	help
	  Port 0 works in device only mode

endchoice

	
config DWC_PORT1_ENABLE
	bool "USB 2.0 port 1"
	depends on UBI32_DWC_OTG
	default n
	help
	  Enable/Disable the second USB port.

choice 
	prompt "Controller mode"
	default DWC_PORT1_HOST
	depends on DWC_PORT1_ENABLE

config DWC_PORT1_HOST
	bool "Host only"
	help
	  Port 1 works in host only mode

config DWC_PORT1_DEVICE
	bool "Device only"
	help
	  Port 1 works in device only mode

endchoice
config DWC_DDMA_DESC
	bool "USB 2.0 Descriptor dma"
	depends on UBI32_DWC_OTG && !UBICOM32_IP8K_SHUTTLE
	default y
	help
	  Enable/Disable the descriptor dma.

config UBI32_XHCI
	bool "USB 3.0 xHCI controller"
	depends on UBICOM32_V5
	default n
	help
	  Enable/Disable USB 3.0 xHCI support

config XHCI_PORT0_ENABLE
	bool "USB 3.0 port W"
	depends on UBI32_XHCI
	default n
	help
	  Enable/Disable the first XHCI port.

config XHCI_PORT1_ENABLE
	bool "USB 3.0 port K"
	depends on UBI32_XHCI
	default y
	help
	  Enable/Disable the first XHCI port.

config UBI32_SS_USB2_MODE
	bool "USB 3.0 support USB 2.0 mode"
	depends on UBI32_XHCI
	default y
	help
	  Enable/Disable USB 3.0 fallback to USB 2.0 mode.

endmenu
```
